## config/boards/shields/SplitISO57/Kconfig.defconfig
```kconfig
if SHIELD_SPLITISO57_LEFT

config ZMK_KEYBOARD_NAME
    default "Split ISO57"

config ZMK_SPLIT_ROLE_CENTRAL
    default y

endif



if SHIELD_SPLITISO57_LEFT || SHIELD_SPLITISO57_RIGHT

config ZMK_SPLIT
    default y

endif
```

## config/boards/shields/SplitISO57/Kconfig.shield
```kconfig
config SHIELD_SPLITISO57_LEFT
    def_bool $(shields_list_contains,SplitISO57_left)

config SHIELD_SPLITISO57_RIGHT
    def_bool $(shields_list_contains,SplitISO57_right)
```
